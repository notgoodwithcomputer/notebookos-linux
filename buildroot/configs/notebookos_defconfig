## buildroot/package/brlaser/Config.in
```kconfig
config BR2_PACKAGE_BRLASER
	bool "brlaser"
	depends on BR2_INSTALL_LIBSTDCPP
	depends on BR2_PACKAGE_CUPS
	help
	  A CUPS driver for the host-based (GDI) Brother laser printers —
	  the DCP / HL / MFC mono models that speak their own raster
	  language instead of PCL or PostScript, so a generic driver makes
	  them receive a job and print nothing. Ships the "brlaser" raster
	  filter and PPDs that Notebook OS's printer setup then offers.

	  https://github.com/pdewacht/brlaser

comment "brlaser needs CUPS and a C++ toolchain"
	depends on !BR2_PACKAGE_CUPS || !BR2_INSTALL_LIBSTDCPP
```

## buildroot/package/captdriver/Config.in
```kconfig
config BR2_PACKAGE_CAPTDRIVER
	bool "captdriver"
	depends on BR2_PACKAGE_CUPS
	help
	  A CUPS driver for Canon's host-based CAPT laser printers
	  (LBP2900/3000, LBP3010/3018/3050) — GDI printers that receive a
	  job and print nothing with a generic driver. Ships the
	  rastertocapt filter and PPDs that Notebook OS's printer setup
	  then offers.

	  https://github.com/mounaiban/captdriver

comment "captdriver needs CUPS"
	depends on !BR2_PACKAGE_CUPS
```

## buildroot/package/ippusb/Config.in
```kconfig
config BR2_PACKAGE_IPPUSB
	bool "ippusb (driverless USB printing)"
	depends on BR2_PACKAGE_CUPS
	depends on BR2_PACKAGE_LIBUSB
	help
	  Driverless printing for USB printers, for printers that have no
	  classic driver.

	  Printers made since roughly 2016 advertise IPP Everywhere /
	  AirPrint and rasterise pages themselves, so the host sends them a
	  PDF and no per-model driver is involved. Manufacturers stopped
	  shipping drivers for them, so the Gutenprint / brlaser / splix
	  driver library does not cover them, and handing one a driver it
	  cannot parse makes it accept the job and print nothing.

	  The usual answer, the ipp-usb daemon, proxies a localhost TCP port
	  onto the printer. That is impossible on this kernel, which has no
	  IP stack at all. But the IPP-USB protocol is HTTP carried on USB
	  bulk endpoints, so this backend speaks it directly over libusb and
	  builds the queue's PPD from the printer's own reported attributes.

comment "ippusb needs CUPS and libusb"
	depends on !BR2_PACKAGE_CUPS || !BR2_PACKAGE_LIBUSB
```

## buildroot/package/jbigkit/Config.in
```kconfig
config BR2_PACKAGE_JBIGKIT
	bool "jbigkit"
	help
	  JBIG-KIT: a small, portable library implementing the JBIG1 / T.85
	  bi-level image compression used by several host-based laser
	  printers (e.g. Samsung QPDL / SPL2 via splix). Provides the
	  static libjbig / libjbig85 used at build time by such drivers.

	  https://www.cl.cam.ac.uk/~mgk25/jbigkit/
```

## buildroot/package/picom/Config.in
```kconfig
config BR2_PACKAGE_PICOM
	bool "picom"
	depends on BR2_PACKAGE_XORG7
	depends on BR2_USE_MMU # fork()
	depends on BR2_TOOLCHAIN_HAS_THREADS
	select BR2_PACKAGE_LIBXCB
	select BR2_PACKAGE_XCB_UTIL
	select BR2_PACKAGE_XCB_UTIL_IMAGE
	select BR2_PACKAGE_XCB_UTIL_RENDERUTIL
	select BR2_PACKAGE_PIXMAN
	select BR2_PACKAGE_LIBCONFIG
	select BR2_PACKAGE_LIBEV
	select BR2_PACKAGE_UTHASH
	help
	  picom is a lightweight standalone compositor for Xorg,
	  suitable for use with window managers that do not provide
	  compositing. It advertises _NET_WM_CM_S0 and implements the
	  _NET_WM_FRAME_DRAWN frame-sync protocol, which drives GTK3's
	  compositor-synced frame clock.

	  https://github.com/yshui/picom

comment "picom needs a toolchain w/ threads"
	depends on BR2_PACKAGE_XORG7
	depends on !BR2_TOOLCHAIN_HAS_THREADS
```

## buildroot/package/splix/Config.in
```kconfig
config BR2_PACKAGE_SPLIX
	bool "splix"
	depends on BR2_INSTALL_LIBSTDCPP
	depends on BR2_PACKAGE_CUPS
	select BR2_PACKAGE_JBIGKIT
	select BR2_PACKAGE_ZLIB
	help
	  SpliX is a CUPS driver for the host-based Samsung SPL2 / QPDL
	  laser printers (ML, SCX, CLP, CLX series) and their Xerox Phaser
	  and Dell rebrands. These are GDI printers that receive a job and
	  print nothing with a generic driver; SpliX ships the rastertoqpdl
	  filter and ~250 PPDs that Notebook OS's printer setup then offers.

	  http://splix.ap2c.org/

comment "splix needs CUPS and a C++ toolchain"
	depends on !BR2_PACKAGE_CUPS || !BR2_INSTALL_LIBSTDCPP
```

## buildroot/package/uthash/Config.in
```kconfig
config BR2_PACKAGE_UTHASH
	bool "uthash"
	help
	  uthash — C preprocessor macros implementing a hash table,
	  linked list, dynamic array and string. Header-only; installed
	  to the staging sysroot for build-time use (e.g. picom).

	  https://github.com/troydhanson/uthash
```

## buildroot/package/vbam/Config.in
```kconfig
config BR2_PACKAGE_VBAM
	bool "vbam (VisualBoyAdvance-M)"
	depends on BR2_INSTALL_LIBSTDCPP
	depends on BR2_TOOLCHAIN_HAS_THREADS
	depends on BR2_PACKAGE_HAS_LIBGL
	select BR2_PACKAGE_SDL2
	select BR2_PACKAGE_LIBPNG
	select BR2_PACKAGE_ZLIB
	select BR2_PACKAGE_LIBGLU
	help
	  VisualBoyAdvance-M, a Game Boy Advance / Game Boy emulator.
	  This builds the lightweight SDL frontend (the "vbam" binary),
	  driven by Notebook OS's GBA Emulator app.

	  https://github.com/visualboyadvance-m/visualboyadvance-m

comment "vbam needs a toolchain w/ C++, threads and an OpenGL provider"
	depends on !BR2_INSTALL_LIBSTDCPP || !BR2_TOOLCHAIN_HAS_THREADS || \
		!BR2_PACKAGE_HAS_LIBGL
```
